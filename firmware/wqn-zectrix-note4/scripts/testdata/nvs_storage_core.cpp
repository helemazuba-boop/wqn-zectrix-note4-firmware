// Production functions + actual SDK Storage/Page/CRC. Only the public handle
// dispatch/lock layer is a single-threaded host bridge. No device or writable
// media: SDK write callbacks always refuse, and original source bytes survive.
#include <algorithm>
#include <array>
#include <cstdint>
#include <cstdio>
#include <cstring>
#include <fstream>
#include <map>
#include <memory>
#include <string>
#include <vector>
#include "nvs_storage.hpp"
#include "esp_log.h"
#include "storage.h"
@@TYPED_HEADER@@

namespace {
std::array<uint8_t,16384> original;
class Partition final : public nvs::Partition {
public:
    std::array<uint8_t,16384> bytes=original;
    unsigned writes=0,erases=0;
    const char* get_partition_name() override {return "nvs";}
    uint32_t get_address() override {return 0;}
    uint32_t get_size() override {return bytes.size();}
    bool get_readonly() override {return false;}
    esp_err_t read(size_t at,void* out,size_t size) override {
        if(at>bytes.size() || size>bytes.size()-at)return ESP_ERR_INVALID_SIZE;
        std::memcpy(out,bytes.data()+at,size);return ESP_OK;
    }
    esp_err_t read_raw(size_t at,void* out,size_t size) override {return read(at,out,size);}
    esp_err_t write(size_t,const void*,size_t) override {++writes;return ESP_ERR_NVS_READ_ONLY;}
    esp_err_t write_raw(size_t at,const void* data,size_t size) override {return write(at,data,size);}
    esp_err_t erase_range(size_t,size_t) override {++erases;return ESP_ERR_NVS_READ_ONLY;}
};
struct Handle {uint8_t ns;int mode;};
std::unique_ptr<Partition> partition;
std::unique_ptr<nvs::Storage> store;
std::map<unsigned,Handle> handles;
unsigned next_handle=1,opens=0,gets=0,finds=0,sets=0,erases=0,commits=0;

std::string lookup_fault,read_fault,disappeared;
void reset() {
    store.reset();partition=std::make_unique<Partition>();store.reset(new(std::nothrow) nvs::Storage(partition.get()));
    if(!store || store->init(0,4)!=ESP_OK || partition->writes || partition->erases){std::fprintf(stderr,"ERROR: SDK fixture initialization\n");std::exit(2);}
    handles.clear();next_handle=1;opens=gets=finds=sets=erases=commits=0;
    lookup_fault.clear();read_fault.clear();disappeared.clear();
}
esp_err_t read_error(const char* key) {
    ++gets;
    if(read_fault==key)return ESP_FAIL;
    if(disappeared==key)return ESP_ERR_NVS_NOT_FOUND;
    return ESP_OK;
}
template<typename T> esp_err_t scalar(nvs_handle_t handle,const char* key,T* out,nvs::ItemType type) {
    const auto err=read_error(key);if(err!=ESP_OK)return err;
    return store->readItem(handles.at(handle).ns,type,key,out,sizeof(T));
}
esp_err_t variable(nvs_handle_t handle,const char* key,void* out,size_t* size,nvs::ItemType type) {
    const auto err=read_error(key);if(err!=ESP_OK)return err;
    size_t required=0;const uint8_t ns=handles.at(handle).ns;
    auto result=store->getItemDataSize(ns,type,key,required);if(result!=ESP_OK)return result;
    if(out==nullptr){*size=required;return ESP_OK;}
    if(*size<required){*size=required;return ESP_ERR_NVS_INVALID_LENGTH;}
    result=store->readItem(ns,type,key,out,required);
    if(result==ESP_OK)*size=required;
    return result;
}
unsigned checks=0,failures=0;
void check(bool good,const char* label) {
    ++checks;if(!good)++failures;
    std::printf("%s typed-nvs: %s\n",good?"PASS":"FAIL",label);
}
}
extern "C" esp_err_t nvs_open(const char* name,nvs_open_mode_t mode,nvs_handle_t* out) {
    ++opens;uint8_t ns=0;
    // Namespace creation is not part of this fixture. All three namespaces are
    // generated by the official tool, even in the missing-values cases.
    auto err=store->createOrOpenNamespace(name,false,ns);if(err!=ESP_OK)return err;
    *out=next_handle++;handles.emplace(*out,Handle{ns,mode});return ESP_OK;
}
extern "C" void nvs_close(nvs_handle_t handle) {handles.erase(handle);}
extern "C" esp_err_t nvs_find_key(nvs_handle_t handle,const char* key,nvs_type_t* out) {
    ++finds;if(lookup_fault==key)return ESP_FAIL;
    nvs::ItemType type;auto err=store->findKey(handles.at(handle).ns,key,&type);if(err!=ESP_OK)return err;
    if(type==nvs::ItemType::BLOB || type==nvs::ItemType::BLOB_IDX)type=nvs::ItemType::BLOB_DATA;
    *out=static_cast<nvs_type_t>(type);return ESP_OK;
}
extern "C" esp_err_t nvs_get_u64(nvs_handle_t h,const char* key,uint64_t* out) {return scalar(h,key,out,nvs::ItemType::U64);}
extern "C" esp_err_t nvs_get_u32(nvs_handle_t h,const char* key,uint32_t* out) {return scalar(h,key,out,nvs::ItemType::U32);}
extern "C" esp_err_t nvs_get_i32(nvs_handle_t h,const char* key,int32_t* out) {return scalar(h,key,out,nvs::ItemType::I32);}
extern "C" esp_err_t nvs_get_u8(nvs_handle_t h,const char* key,uint8_t* out) {return scalar(h,key,out,nvs::ItemType::U8);}
extern "C" esp_err_t nvs_get_blob(nvs_handle_t h,const char* key,void* out,size_t* size) {return variable(h,key,out,size,nvs::ItemType::BLOB);}
extern "C" esp_err_t nvs_get_str(nvs_handle_t h,const char* key,char* out,size_t* size) {return variable(h,key,out,size,nvs::ItemType::SZ);}
extern "C" esp_err_t nvs_set_blob(nvs_handle_t h,const char* key,const void* data,size_t size) {
    ++sets;return store->writeItem(handles.at(h).ns,nvs::ItemType::BLOB,key,data,size);
}
extern "C" esp_err_t nvs_erase_key(nvs_handle_t h,const char* key) {
    ++erases;return store->eraseItem(handles.at(h).ns,nvs::ItemType::ANY,key);
}
extern "C" esp_err_t nvs_commit(nvs_handle_t) {++commits;return ESP_OK;}
#define ESP_RETURN_ON_ERROR(expr,...) do {const auto error=(expr);if(error!=ESP_OK)return error;} while(false)

namespace business {
constexpr const char* WQN_NVS_NAMESPACE="wqn";
[[maybe_unused]] constexpr const char* kTag="typed-nvs-test";
@@BUSINESS@@
}
namespace wqn {
using business::NvsHandle;
constexpr const char* WQN_NVS_NAMESPACE="wqn";
[[maybe_unused]] constexpr const char* kTag="typed-nvs-test";
constexpr const char* kDeckScopeGenKey="word_deck_gen";
constexpr const char* kDeckScopeMarkerKey="word_deck_chg";
constexpr int kVolumeDefaultPercent=100;
constexpr const char* kAudioNamespace="audio";
constexpr const char* kVolumeNvsKey="output_volume";
@@PUBLIC@@
}
namespace boot {
using business::NvsHandle;
[[maybe_unused]] constexpr const char* kTag="typed-boot-test";
constexpr const char* kSchemaNamespace="wqn_boot";
constexpr const char* kGenerationKey="schema_gen";
constexpr const char* kResetIdKey="reset_id";
constexpr const char* kResetIntentKey="reset_pending";
constexpr size_t kResetIdBytes=16;
using ResetId=std::array<uint8_t,kResetIdBytes>;
constexpr std::array<uint8_t,12> kIntentHeader={'W','Q','N','R','S','T',1,0,3,0,0,0};
using ResetIntent=std::array<uint8_t,kIntentHeader.size()+kResetIdBytes>;
@@BOOT@@
}

int main(int argc,char** argv) {
    if(argc!=3)return 2;
    std::ifstream file(argv[2],std::ios::binary);
    if(!file.read(reinterpret_cast<char*>(original.data()),original.size()) || file.peek()!=EOF)return 2;
    const std::string kind=argv[1];
    const char* keys[]={"cur_seq","cur_rnd","cur_dic","cur_rev","cur_int","cur_shf","cur_mis"};
    if(kind=="wrong"){
        reset();nvs_handle_t h=0;nvs_open("wqn",NVS_READONLY,&h);uint64_t value=0;nvs_type_t type=NVS_TYPE_ANY;
        check(nvs_get_u64(h,"word_deck_gen",&value)==ESP_ERR_NVS_NOT_FOUND && nvs_find_key(h,"word_deck_gen",&type)==ESP_OK && type==NVS_TYPE_U32,"actual SDK typed NOT_FOUND with existing u32");nvs_close(h);
        for(const char* key:{"word_deck_gen","word_seq_idx"}){
            reset();bool found=true;uint64_t out=99;
            check(business::LoadU64FromNvs(key,&out,&found)==ESP_ERR_NVS_TYPE_MISMATCH && !found,"wrong u64 type is error, not generation/index zero");
        }
        for(const char* key:{"word_deck","word_deck_chg"}){
            reset();std::string out="keep";
            check(business::LoadStringFromNvs(key,&out)==ESP_ERR_NVS_TYPE_MISMATCH && out=="keep","wrong scope text cannot become missing marker/deck");
        }
        reset();std::string string="keep";
        check(business::LoadStringFromNvs("wifi_ssid",&string)==ESP_ERR_NVS_TYPE_MISMATCH && string=="keep","generic string wrong type preserved as error");
        reset();string="keep";
        check(business::LoadBlobFromNvs("wifi_creds",&string)==ESP_ERR_NVS_TYPE_MISMATCH && string=="keep","generic blob wrong type preserved as error");
        for(const char* key:keys){
            reset();std::array<uint8_t,52> out{};out.fill(0xa5);const auto before=out;bool found=true;
            check(wqn::LoadWordSessionCursorNvs(key,out.data(),out.size(),&found)==ESP_ERR_NVS_TYPE_MISMATCH && !found && out==before,"wrong cursor type cannot permit legacy fallback");
        }
        reset();std::array<uint8_t,52> bytes{};
        check(wqn::SaveWordSessionCursorNvs("cur_seq",bytes.data(),bytes.size())==ESP_ERR_NVS_TYPE_MISMATCH && sets==0 && partition->writes==0,"wrong cursor type cannot be overwritten");
        reset();check(wqn::ClearWordSessionCursorNvs("cur_seq")==ESP_ERR_NVS_TYPE_MISMATCH && erases==0 && partition->writes==0,"wrong cursor type cannot be silently erased");
        reset();int volume=-1;check(wqn::LoadVolumePercent(&volume)==ESP_ERR_NVS_TYPE_MISMATCH && volume==-1,"unsupported volume type is explicit error");
    } else if(kind=="valid" || kind=="legacy"){
        reset();uint64_t value=0;bool found=false;
        check(business::LoadU64FromNvs("word_deck_gen",&value,&found)==ESP_OK && found && value==17,"valid committed generation unchanged");
        reset();std::string value_string;
        check(business::LoadStringFromNvs("wifi_ssid",&value_string)==ESP_OK && value_string=="synthetic-net","canonical string bytes");
        reset();check(business::LoadBlobFromNvs("wifi_creds",&value_string)==ESP_OK && value_string==std::string("\x01\x02\x03",3),"canonical blob bytes");
        for(const char* key:keys){reset();std::array<uint8_t,52> out{};bool has=false;check(wqn::LoadWordSessionCursorNvs(key,out.data(),out.size(),&has)==ESP_OK && has && out[0]=='R',"supported cursor blob read");}
        reset();int volume=-1;check(wqn::LoadVolumePercent(&volume)==ESP_OK && volume==37,"legacy u8 volume is selected explicitly");
        reset();std::array<uint8_t,52> bytes{};bytes.fill('R');check(wqn::SaveWordSessionCursorNvs("cur_seq",bytes.data(),bytes.size())==ESP_OK && sets==0 && partition->writes==0,"unchanged cursor remains write-free");
        reset();bytes.fill('S');check(wqn::SaveWordSessionCursorNvs("cur_seq",bytes.data(),bytes.size())==ESP_ERR_NVS_READ_ONLY && sets==1 && partition->writes>0,"supported changed cursor reaches existing SDK write path");
        reset();check(wqn::ClearWordSessionCursorNvs("cur_seq")==ESP_ERR_NVS_READ_ONLY && erases==1 && partition->writes>0,"supported cursor clear reaches SDK erase path");
        for(const char* key:{"word_deck_gen","cur_seq","word_deck_chg"}){
            reset();lookup_fault=key;
            if(std::strcmp(key,"word_deck_gen")==0){uint64_t out=9;bool has=false;check(business::LoadU64FromNvs(key,&out,&has)==ESP_FAIL && gets==0,"lookup failure blocks scalar read");}
            else if(std::strcmp(key,"cur_seq")==0){std::array<uint8_t,52> out{};bool has=false;check(wqn::LoadWordSessionCursorNvs(key,out.data(),out.size(),&has)==ESP_FAIL && gets==0,"lookup failure blocks cursor read");}
            else {std::string out="keep";check(business::LoadStringFromNvs(key,&out)==ESP_FAIL && gets==0 && out=="keep","lookup failure blocks marker read");}
        }
        for(const char* key:{"word_deck_gen","cur_seq","word_deck"}){
            reset();disappeared=key;
            if(std::strcmp(key,"word_deck_gen")==0){uint64_t out=9;bool has=false;check(business::LoadU64FromNvs(key,&out,&has)==ESP_ERR_NVS_NOT_FOUND && !has,"disappearance after presence is not default generation");}
            else if(std::strcmp(key,"cur_seq")==0){std::array<uint8_t,52> out{};bool has=false;check(wqn::LoadWordSessionCursorNvs(key,out.data(),out.size(),&has)==ESP_ERR_NVS_NOT_FOUND && !has,"disappearance cannot permit legacy cursor fallback");}
            else {std::string out="keep";check(business::LoadStringFromNvs(key,&out)==ESP_ERR_NVS_NOT_FOUND && out=="keep","disappearance cannot become missing scope text");}
        }
    } else if(kind=="absent"){
        reset();uint64_t value=99;bool found=true;check(business::LoadU64FromNvs("word_deck_gen",&value,&found)==ESP_OK && !found && value==0,"genuine absent generation stays initial zero");
        reset();std::string text="old";check(business::LoadStringFromNvs("word_deck_chg",&text)==ESP_OK && text.empty(),"genuine absent marker remains absent");
        reset();std::array<uint8_t,52> bytes{};bool has=true;check(wqn::LoadWordSessionCursorNvs("cur_seq",bytes.data(),bytes.size(),&has)==ESP_OK && !has,"genuine absent cursor permits normal legacy path");
        reset();int volume=-1;check(wqn::LoadVolumePercent(&volume)==ESP_OK && volume==100,"genuine absent volume keeps default");
        reset();check(wqn::ClearWordSessionCursorNvs("cur_seq")==ESP_OK && erases==0,"genuine absent cursor clear is write-free");
        reset();check(wqn::SaveWordSessionCursorNvs("cur_seq",bytes.data(),bytes.size())==ESP_ERR_NVS_READ_ONLY && sets==1,"genuine absent cursor permits normal creation path");
    } else if(kind=="boot-wrong"){
        reset();uint32_t generation=0;bool found=false;boot::ResetId id{};size_t size=0;
        check(boot::ReadSchemaMarker(&generation,&found,&id,&size)==ESP_ERR_NVS_TYPE_MISMATCH,"wrong boot generation cannot become fresh schema");
        reset();check(boot::ReadResetIntent(&found,&id)==ESP_ERR_NVS_TYPE_MISMATCH && !found,"wrong reset intent cannot be ignored");
    } else if(kind=="boot-id-wrong"){
        reset();uint32_t generation=0;bool found=false;boot::ResetId id{};size_t size=0;
        check(boot::ReadSchemaMarker(&generation,&found,&id,&size)==ESP_ERR_NVS_TYPE_MISMATCH,"wrong reset id cannot become missing marker");
    } else if(kind=="boot-valid"){
        reset();uint32_t generation=0;bool found=false;boot::ResetId id{};size_t size=0;
        check(boot::ReadSchemaMarker(&generation,&found,&id,&size)==ESP_OK && found && generation==3 && size==16,"valid boot marker unchanged");
        reset();check(boot::ReadResetIntent(&found,&id)==ESP_OK && found && id[0]==0x11,"valid reset intent observed without replay");
        for(const char* key:{"schema_gen","reset_id","reset_pending"}){
            reset();disappeared=key;
            if(std::strcmp(key,"reset_pending")==0)check(boot::ReadResetIntent(&found,&id)==ESP_ERR_NVS_NOT_FOUND && !found,"reset intent disappearance is not absence");
            else check(boot::ReadSchemaMarker(&generation,&found,&id,&size)==ESP_ERR_NVS_NOT_FOUND,"boot marker disappearance is explicit error");
            reset();lookup_fault=key;
            if(std::strcmp(key,"reset_pending")==0)check(boot::ReadResetIntent(&found,&id)==ESP_FAIL,"reset intent lookup error propagates");
            else check(boot::ReadSchemaMarker(&generation,&found,&id,&size)==ESP_FAIL,"boot marker lookup error propagates");
        }
    } else if(kind=="volume-i32"){
        reset();int percent=-1;check(wqn::LoadVolumePercent(&percent)==ESP_OK && percent==73,"current i32 volume format");
    } else if(kind=="volume-low" || kind=="volume-high"){
        reset();int percent=-1;check(wqn::LoadVolumePercent(&percent)==ESP_OK && percent==(kind=="volume-low"?0:100),"supported volume values retain clamping policy");
    } else if(kind=="cursor-size"){
        reset();std::array<uint8_t,52> bytes{};bool found=true;
        check(wqn::LoadWordSessionCursorNvs("cur_seq",bytes.data(),bytes.size(),&found)==ESP_ERR_INVALID_SIZE && !found,"unknown blob length cannot permit cursor fallback");
        reset();check(wqn::SaveWordSessionCursorNvs("cur_seq",bytes.data(),bytes.size())==ESP_ERR_INVALID_SIZE && sets==0 && partition->writes==0,"unknown blob length cannot be overwritten");
    } else if(kind=="blob-empty"){
        reset();std::string value="keep";
        check(business::LoadBlobFromNvs("wifi_creds",&value)==ESP_OK && value.empty(),"genuine empty blob remains supported");
    } else if(kind=="string-embedded-nul" || kind=="string-empty-sdk"){
        reset();std::string value="keep";
        check(business::LoadStringFromNvs("wifi_ssid",&value)==ESP_ERR_INVALID_SIZE && value=="keep","noncanonical SDK string does not become a truncated/default value");
    } else return 2;
    check(partition->bytes==original,"original RAM media bytes unchanged");
    store.reset();partition.reset();handles.clear();
    std::printf("NVS storage core: %u checks, %u failures (actual SDK and production functions; host bridge; NOT HIL)\n",checks,failures);
    return failures?1:0;
}
