## firmware/wqn-zectrix-note4/main/Kconfig.projbuild
```kconfig
menu "WQN firmware"

    config WQN_MEMORY_DIAGNOSTICS
        bool "Enable bounded RAM diagnostics"
        default y
        help
            Log internal byte-addressable, internal DMA and PSRAM heap samples
            periodically and at WiFi/cloud/AI/audio worker boundaries. Failed
            allocations are captured without logging or allocating in the hook.
            A low-priority worker drains bounded rings; overwrites are counted.
            Its 4 KiB stack uses PSRAM when external task stacks are allowed.

    config WQN_MEMORY_SAMPLE_SECONDS
        int "RAM sample interval in seconds"
        depends on WQN_MEMORY_DIAGNOSTICS
        default 30
        range 5 3600

    config WQN_MEMORY_TRACE_ENABLE
        bool "Run one short standalone heap trace per boot"
        depends on WQN_MEMORY_DIAGNOSTICS && HEAP_TRACING_STANDALONE
        default n
        help
            Diagnostic builds only: start a single HEAP_TRACE_LEAKS window after
            the configured boot delay, then stop automatically and gradually
            log remaining allocations with caller addresses. Live allocations
            are not proof of a leak. Buffer overflow is reported explicitly.
            Enable standalone tracing under Component config / Heap memory
            debugging first. Normal builds keep heap tracing disabled.

    config WQN_MEMORY_HISTORY_ENABLE
        bool "Keep RAM diagnostic history in PSRAM for offline tests"
        depends on WQN_MEMORY_DIAGNOSTICS && SPIRAM && WQN_DEV_MENU_ENABLE
        default y
        help
            Keep one snapshot per minute, 128 recent operation/event snapshots,
            and 32 recent allocation failures in a fixed PSRAM allocation.
            Open Developer / Build and runtime info after attaching the no-reset
            USB monitor to export the retained history. Export is asynchronous
            and does not erase history. No Flash writes are performed.
            All history is lost on restart, power loss, or deep sleep.

    config WQN_MEMORY_HISTORY_HOURS
        int "RAM history retention capacity in hours"
        depends on WQN_MEMORY_HISTORY_ENABLE
        default 24
        range 1 48
        help
            Capacity at the default one-minute history interval. With the
            default 30-second live sampling, 24 hours uses about 112 KiB PSRAM.
            A live sample interval above 60 seconds reduces history resolution.

    config WQN_MEMORY_TRACE_DELAY_SECONDS
        int "Heap trace start delay since boot in seconds"
        depends on WQN_MEMORY_TRACE_ENABLE
        default 60
        range 0 86400

    config WQN_MEMORY_TRACE_SECONDS
        int "Heap trace window in seconds"
        depends on WQN_MEMORY_TRACE_ENABLE
        default 5
        range 1 30

    config WQN_MEMORY_TRACE_RECORDS
        int "Maximum heap trace records (internal RAM)"
        depends on WQN_MEMORY_TRACE_ENABLE
        default 128
        range 16 256

    config WQN_WIFI_STA_ENABLE
        bool "Enable WQN WiFi station"
        default n
        help
            Enable the minimal WiFi station flow. Keep this disabled for the
            offline board-diagnostics build and until CMOS5 plus backup restore
            checks are complete.

    config WQN_WIFI_SSID
        string "WQN WiFi SSID"
        default ""
        depends on WQN_WIFI_STA_ENABLE
        help
            Development WiFi SSID. This value is stored only in local sdkconfig,
            which is ignored by git.

    config WQN_WIFI_PASSWORD
        string "WQN WiFi password"
        default ""
        depends on WQN_WIFI_STA_ENABLE
        help
            Development WiFi password. This value is stored only in local
            sdkconfig, which is ignored by git.

    config WQN_PROVISION_ENABLE
        bool "Enable WiFi provisioning (SoftAP + captive portal)"
        default y
        depends on WQN_WIFI_STA_ENABLE
        help
            Enable in-app WiFi provisioning for new users with no saved
            credentials. Starts a captive portal on SoftAP "ZECTRIX_XXXX"
            at http://192.168.4.1 when no NVS WiFi credentials are found.
            Set to n only when using a fixed compile-time SSID/password
            or when the device is always offline.

    config WQN_DEVICE_CONTROL_V3_ENABLE
        bool "Use device-control v3 claim/bootstrap/sync"
        default y
        depends on WQN_WIFI_STA_ENABLE
        help
            Route device claim, authenticated bootstrap and summary sync through
            /api/esp32/v3. Production WiFi builds require this after the M7
            cutover; AI SSE remains v2-streaming and Flash remains wqn-flash-v2.

    config WQN_EPD_UI_ENABLE
        bool "Enable ZecTrix Note4 e-paper UI"
        default n
        help
            Enable the first hardware UI path using the Note4 400x300 e-paper
            panel and physical buttons. This powers GPIO6 for display refreshes.
            Keep disabled for headless network-only builds.

    config WQN_EPD_LOCAL_PARTIAL_ENABLE
        bool "Enable local EPD partial-window refresh"
        default y
        depends on WQN_EPD_UI_ENABLE
        help
            Enable the Note4 controller's 0x83 local partial-window refresh
            path. This keeps the EPD rail powered after refreshes so the panel
            controller can preserve hot-refresh state between UI operations.

    config WQN_EPD_PARTIAL_COOLDOWN_MS
        int "EPD local partial cooldown in milliseconds"
        default 450
        range 0 2000
        depends on WQN_EPD_LOCAL_PARTIAL_ENABLE
        help
            Minimum delay between local partial refreshes. The closed firmware
            waits for both BUSY release and a software cooldown before sending
            the next 0x83 window.

    config WQN_EPD_IDLE_POWER_OFF_MS
        int "Power off EPD rail after UI idle milliseconds"
        default 5000
        range 0 600000
        depends on WQN_EPD_UI_ENABLE
        help
            Cut GPIO6 after the UI has been idle for this long. The previous
            framebuffer stays synced in CPU memory, so later partial refreshes
            can still diff against the visible panel image after a cold rail
            restart. Set 0 to keep the EPD rail on as long as the firmware is
            running.

    config WQN_EPD_IDLE_CLEANUP_MS
        int "Heavy-partial cleanup full refresh idle threshold in milliseconds"
        default 45000
        range 0 600000
        depends on WQN_EPD_UI_ENABLE
        help
            User-idle time before the EPD owner task discharges accumulated
            heavy-partial debt (kIdleCleanupHeavyPartials) with one full
            refresh. This is deliberately NOT the power-off point: while the
            cleanup rode WQN_EPD_IDLE_POWER_OFF_MS, every pause longer than a
            few seconds flashed the panel even though nothing had changed.
            The EPD owner tracks this deadline independently of UI polling
            and retained standby. No cleanup wake is scheduled without debt.
            A cold rail is fine: the genuine full refresh powers the panel
            itself and ends with the
            rail down again. Set 0 to attach the cleanup back to the
            power-off point (pre-2026-09-11 behaviour).

    config WQN_DEEP_SLEEP_ENABLE
        bool "Enable deep sleep after UI idle"
        default y
        depends on WQN_EPD_UI_ENABLE
        help
            Enter ESP32-S3 deep sleep after the UI has been idle. Wake sources
            are RTC-capable GPIO0, GPIO18, and GPIO5. GPIO39 cannot wake from
            deep sleep on ESP32-S3. GPIO17 is held high to preserve board power.

    config WQN_RETAINED_STANDBY_IDLE_MS
        int "Retained standby idle timeout in milliseconds"
        default 60000
        range 1000 86400000
        depends on PM_ENABLE && FREERTOS_USE_TICKLESS_IDLE
        help
            User-idle time before the UI switches to an event/deadline-driven
            wait. Automatic light sleep then retains RAM, PSRAM and the display
            framebuffer, so every button (including GPIO39) remains a wake
            source without rebooting the firmware.

    config WQN_DEEP_SLEEP_IDLE_MS
        int "Deep sleep idle timeout in milliseconds"
        default 1800000
        range 10000 86400000
        depends on WQN_DEEP_SLEEP_ENABLE
        help
            Idle time before the stateless provisioning/background screen may
            enter deep sleep. Ordinary application pages have no hibernate
            contract and use retained standby instead. The default is 30
            minutes.

    config WQN_SLEEP_TIMER_WAKE_FLOOR_SEC
        int "Minimum deep sleep timer wake interval in seconds"
        default 60
        range 0 86400
        depends on WQN_DEEP_SLEEP_ENABLE
        help
            Floor applied to any non-zero computed timer wake interval.
            Sync retry/content deadlines shorter than this are folded into
            one wake per interval instead of a boot-per-10s micro-wake loop;
            a deadline that lands inside the floor simply fires one interval
            late. 0 disables the floor.

    config WQN_RTC_TIMEKEEP_ENABLE
        bool "Keep wall-clock time across deep sleep via PCF8563"
        default y
        depends on WQN_DEEP_SLEEP_ENABLE
        help
            Before entering deep sleep, write the system wall clock into the
            PCF8563 RTC; on a trusted deep-sleep resume, read it back and
            calibrate the system clock before UI/sync consumers start. Any
            failure degrades safely to the existing build-time seed.

    config WQN_AI_ENABLE
        bool "Enable WQN AI firmware modules"
        default n
        help
            Enable experimental AI support modules. Provider secrets must stay
            on the WQN server and must never be embedded in firmware.

    config WQN_AUDIO_RESOURCE_DIAGNOSTICS
        bool "Enable detailed audio heap/task diagnostics"
        default n
        depends on WQN_AI_ENABLE && FREERTOS_USE_TRACE_FACILITY
        help
            Print the full heap and task ledger only while capture is inactive.
            Keep disabled for recording acceptance: the serial dump can occupy
            hundreds of milliseconds and interfere with DMA draining.

    config WQN_AGENT_ENABLE
        bool "Enable the Agent tier (OpenCode gateway)"
        default y
        depends on WQN_AI_ENABLE
        help
            Compile the Agent tier of the AI page: the OpenCode gateway that
            proxies a self-hosted OpenCode server through the WQN cloud
            (/api/esp32/agent/*), its worker task, and its session picker.

            Provider secrets and tool execution stay on the gateway; the device
            only ever holds the pairing token.

            When disabled, AiTier::kAgent is dropped from the tier ring so the
            user can never land on a tier with no backend behind it, and the
            OpenCode session/client translation units compile to stubs. Disable
            only for builds against a cloud that does not serve the agent
            routes.

    config WQN_FLASH_PROTOCOL_V2
        bool "Flash mode uses the wqn-flash-v2 Realtime protocol (WQN proxy)"
        default y
        depends on WQN_AI_ENABLE
        help
            The new WS endpoint is wss://wqn.helema.cn/api/esp32/realtime with
            Sec-WebSocket-Protocol: wqn-flash-v2. Uplink audio is PCM16 binary
            frames (480 B each), downlink TTS audio is also binary and is
            rendered to ES8311 via the existing flash I2S duplex path.
            Disabling selects a compile-only legacy StepFun-shaped fallback.
            Both modes use the per-device pairing Bearer token; a legacy
            deployment must independently verify it (for example auth_request
            to /api/esp32/auth-verify). No firmware-wide shared key is sent.
            Legacy runtime service acceptance is not release-verified.

    config WQN_AI_AUDIO_SELFTEST_ENABLE
        bool "Run WQN audio capture self-test at boot"
        default n
        depends on WQN_AI_ENABLE
        help
            Initialize the ES8311/I2S microphone path, capture a short sample,
            print channel RMS/peak statistics over serial, then power audio off.
            This mode does not upload audio or start WiFi by itself.

    config WQN_AI_PCM_DUMP_ENABLE
        bool "Dump captured AI turn PCM as base64 over the console"
        default n
        depends on WQN_AI_ENABLE
        help
            After each AI recording stops, print the loudest 2 s window of
            the captured mono PCM as base64 between PCM_DUMP_BEGIN and
            PCM_DUMP_END markers. Diagnostic only: at 115200 baud this
            blocks the AI worker for roughly 10 s per turn, so never enable
            it outside a targeted capture session.

    config WQN_DEV_MENU_ENABLE
        bool "Enable the dev diagnostics submenu in the settings page"
        default n
        depends on WQN_EPD_UI_ENABLE
        help
            Adds one "开发者选项" row to the settings page that opens a
            second-level read-only list: dev info, sync diagnostics, error log,
            raw battery, storage detail and sleep/power diagnostics. Structure
            is fixed by docs/development/DEV_DIAGNOSTICS.md. Error capture (wqn::RecordError) is
            always compiled in; this flag only controls the visible menu entry,
            so release builds keep it n (RELEASE_CHECKLIST.md asserts the
            recorded sdkconfig has it unset).

endmenu
```
