#pragma once

#include <array>
#include <cstddef>
#include <cstdint>

// Production subset of the reference demo's SSD2683 waveform catalog. Keep
// this byte-for-byte aligned with zectrix-note4-epd-demo; the omitted material
// is calibration/diagnostic machinery not used by the firmware render path.
namespace ssd2683_waveform {

constexpr size_t kWaveformSize = 535;
constexpr size_t kAnalogConfigSize = 7;
constexpr size_t kTableCount = 6;
constexpr size_t kTableSize = 88;
constexpr size_t kRecordsPerTable = 8;
constexpr size_t kRecordSize = 11;
constexpr size_t kVendorScreeningCodesPerPass = 3;
constexpr size_t kVendorGray16Count = 16;

static_assert(kAnalogConfigSize + kTableCount * kTableSize == kWaveformSize);
static_assert(kRecordsPerTable * kRecordSize == kTableSize);

constexpr uint32_t Fnv1a32(
    const std::array<uint8_t, kWaveformSize>& waveform)
{
    uint32_t hash = 2166136261u;
    for (uint8_t value : waveform) {
        hash ^= value;
        hash *= 16777619u;
    }
    return hash;
}

// Panel vendor's production four-gray waveform, including its analog
// parameters (PWR 00 14 78 78 14, VCOM 0x85, PLL 0x08).
constexpr std::array<uint8_t, kWaveformSize> kVendorGray4Waveform = {{
    0x00, 0x14, 0x78, 0x78, 0x14, 0x85, 0x08, 0xEF, 0xEF, 0xEF, 0xAF, 0x2F,
    0xFF, 0xEF, 0xAF, 0xFF, 0xEF, 0xEF, 0xEF, 0xEF, 0xEF, 0x3F, 0x7F, 0xFF,
    0xEF, 0x7F, 0x3F, 0xFF, 0xEF, 0xEF, 0xEF, 0xEF, 0xFF, 0xEF, 0xFF, 0xEF,
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    0xFF, 0xFF, 0xFF, 0xFF, 0xFF, 0xFF, 0xFF,
}};


static_assert(Fnv1a32(kVendorGray4Waveform) == 0x54F54E58u,
              "SSD2683 vendor waveform payload changed");

struct VendorGraySpec {
    size_t base_table;
    size_t alternate_table;
    uint8_t alternate_mask;
};

constexpr VendorGraySpec kVendorHoldSpec = {5, 5, 0x00};

constexpr std::array<uint8_t, kWaveformSize> MakeVendorCodeWaveform(
    const std::array<VendorGraySpec, 4>& codes)
{
    std::array<uint8_t, kWaveformSize> waveform = kVendorGray4Waveform;
    for (size_t code = 0; code < codes.size(); ++code) {
        const size_t destination_begin =
            kAnalogConfigSize + (code + 1) * kTableSize;
        for (size_t record = 0; record < kRecordsPerTable; ++record) {
            const bool alternate =
                ((codes[code].alternate_mask >> record) & 0x01u) != 0;
            const size_t source =
                kAnalogConfigSize +
                (alternate ? codes[code].alternate_table
                           : codes[code].base_table) *
                    kTableSize +
                record * kRecordSize;
            const size_t destination =
                destination_begin + record * kRecordSize;
            for (size_t byte = 0; byte < kRecordSize; ++byte) {
                waveform[destination + byte] =
                    kVendorGray4Waveform[source + byte];
            }
        }
    }
    return waveform;
}

// Final calibrated palette from the reference demo. Level 15 is intentionally
// left on the OTP-white base; levels 0..14 are painted three at a time.
constexpr std::array<VendorGraySpec, kVendorGray16Count>
    kVendorGray16Targets = {{
        {1, 1, 0x00}, {3, 1, 0x30}, {2, 3, 0x02}, {3, 1, 0x04},
        {3, 1, 0x10}, {3, 4, 0x05}, {3, 4, 0x04}, {3, 4, 0x01},
        {3, 4, 0x0C}, {2, 3, 0x20}, {3, 4, 0x44}, {3, 2, 0x44},
        {3, 4, 0x40}, {3, 4, 0x14}, {3, 4, 0x10}, {4, 2, 0x40},
    }};

constexpr size_t kVendorGray16PaintedCount = kVendorGray16Count - 1;
constexpr size_t kVendorGray16RenderPassCount =
    (kVendorGray16PaintedCount + kVendorScreeningCodesPerPass - 1) /
    kVendorScreeningCodesPerPass;

constexpr std::array<uint8_t, kWaveformSize>
MakeVendorGray16RenderWaveform(size_t pass)
{
    std::array<VendorGraySpec, 4> codes = {
        kVendorHoldSpec, kVendorHoldSpec, kVendorHoldSpec, kVendorHoldSpec};
    for (size_t slot = 0; slot < kVendorScreeningCodesPerPass; ++slot) {
        const size_t level = pass * kVendorScreeningCodesPerPass + slot;
        if (level < kVendorGray16PaintedCount) {
            codes[slot + 1] = kVendorGray16Targets[level];
        }
    }
    return MakeVendorCodeWaveform(codes);
}

constexpr std::array<std::array<uint8_t, kWaveformSize>,
                     kVendorGray16RenderPassCount>
MakeVendorGray16RenderWaveforms()
{
    std::array<std::array<uint8_t, kWaveformSize>,
               kVendorGray16RenderPassCount> waveforms = {};
    for (size_t pass = 0; pass < waveforms.size(); ++pass) {
        waveforms[pass] = MakeVendorGray16RenderWaveform(pass);
    }
    return waveforms;
}

constexpr auto kVendorGray16RenderWaveforms =
    MakeVendorGray16RenderWaveforms();

constexpr size_t VendorGray16RenderPassOfLevel(size_t level)
{
    return level < kVendorGray16PaintedCount
        ? level / kVendorScreeningCodesPerPass
        : kVendorGray16RenderPassCount;
}

constexpr uint8_t VendorGray16RenderCodeOfLevel(size_t level)
{
    return level < kVendorGray16PaintedCount
        ? static_cast<uint8_t>(level % kVendorScreeningCodesPerPass + 1)
        : 0;
}

constexpr bool ValidateVendorGray16Waveforms()
{
    for (const auto& waveform : kVendorGray16RenderWaveforms) {
        for (size_t record = 0; record < kRecordsPerTable; ++record) {
            const size_t hold =
                kAnalogConfigSize + kTableSize + record * kRecordSize;
            if (waveform[hold + 1] != 0xFF ||
                waveform[hold + 2] != 0xFF) {
                return false;
            }
        }
        for (size_t i = 0; i < kAnalogConfigSize; ++i) {
            if (waveform[i] != kVendorGray4Waveform[i]) {
                return false;
            }
        }
    }
    return VendorGray16RenderCodeOfLevel(15) == 0 &&
        VendorGray16RenderPassOfLevel(15) == kVendorGray16RenderPassCount;
}

static_assert(ValidateVendorGray16Waveforms(),
              "gray16 LUT must preserve vendor analog values and hold code 0");

}  // namespace ssd2683_waveform
